## esp32/components/muse/Kconfig
```kconfig
# Copyright (c) Meta Platforms, Inc. and affiliates.
#
# Licensed under the Apache License, Version 2.0 (the "License");
# you may not use this file except in compliance with the License.
# You may obtain a copy of the License at
#
#     http://www.apache.org/licenses/LICENSE-2.0
#
# Unless required by applicable law or agreed to in writing, software
# distributed under the License is distributed on an "AS IS" BASIS,
# WITHOUT WARRANTIES OR CONDITIONS OF ANY KIND, either express or implied.
# See the License for the specific language governing permissions and
# limitations under the License.

menu "Muse"

    choice MUSE_BOARD
        prompt "Board with the full UI"
        default MUSE_BOARD_NONE
        help
            The UI is the voice companion on boards with a screen: an
            animated avatar, push-to-talk chat, settings, and battery
            handling. It runs beside Home Link, which owns Wi-Fi, BLE
            pairing, credentials and OTA. Pick the board it runs on, or none
            for a Link without a display.

        config MUSE_BOARD_NONE
            bool "None (Home Link without a display)"

        config MUSE_BOARD_WAVESHARE_S3_175C
            bool "Waveshare ESP32-S3-Touch-AMOLED-1.75C"
            depends on IDF_TARGET_ESP32S3

        config MUSE_BOARD_WAVESHARE_S3_175
            bool "Waveshare ESP32-S3-Touch-AMOLED-1.75 (not the 1.75C)"
            depends on IDF_TARGET_ESP32S3

        config MUSE_BOARD_WAVESHARE_S3_LCD_185C
            bool "Waveshare ESP32-S3-Touch-LCD-1.85C"
            depends on IDF_TARGET_ESP32S3

        config MUSE_BOARD_AIPI
            bool "AIPI Lite (ESP32-S3, two buttons, no touch)"
            depends on IDF_TARGET_ESP32S3

        config MUSE_BOARD_ESPRESSIF_BOX_3
            bool "Espressif ESP32-S3-BOX-3 (320x240 touch LCD, speaker and microphones)"
            depends on IDF_TARGET_ESP32S3

        config MUSE_BOARD_WAVESHARE_C6_18
            bool "Waveshare ESP32-C6-Touch-AMOLED-1.8"
            depends on IDF_TARGET_ESP32C6

        config MUSE_BOARD_SENSECAP_WATCHER
            bool "Seeed SenseCAP Watcher (ESP32-S3, round touch LCD, wheel)"
            depends on IDF_TARGET_ESP32S3

        config MUSE_BOARD_M5STACK_CARDPUTER_ADV
            bool "M5Stack Cardputer ADV (ESP32-S3, keyboard, no PSRAM)"
            depends on IDF_TARGET_ESP32S3

        config MUSE_BOARD_M5STACK_STICKS3
            bool "M5Stack StickS3 (ESP32-S3, two buttons, no touch)"
            depends on IDF_TARGET_ESP32S3

        config MUSE_BOARD_M5STACK_STICKC_PLUS2
            bool "M5Stack StickC Plus2 (ESP32, two buttons, no touch)"
            depends on IDF_TARGET_ESP32

        config MUSE_BOARD_M5STACK_STOPWATCH
            bool "M5Stack StopWatch (ESP32-S3, round touch AMOLED)"
            depends on IDF_TARGET_ESP32S3

        config MUSE_BOARD_M5STACK_CORES3
            bool "M5Stack CoreS3 (ESP32-S3, 320x240 touch LCD, speaker and microphones)"
            depends on IDF_TARGET_ESP32S3
    endchoice

    config MUSE_ENABLED
        bool
        default y if !MUSE_BOARD_NONE

    # Always defined, unlike the target-dependent board options, so
    # idf_component.yml rules can select each board's managed components.
    config MUSE_BOARD_ID
        string
        default "waveshare_s3_175c" if MUSE_BOARD_WAVESHARE_S3_175C
        default "waveshare_s3_175" if MUSE_BOARD_WAVESHARE_S3_175
        default "waveshare_s3_lcd_185c" if MUSE_BOARD_WAVESHARE_S3_LCD_185C
        default "aipi" if MUSE_BOARD_AIPI
        default "espressif_box_3" if MUSE_BOARD_ESPRESSIF_BOX_3
        default "waveshare_c6_18" if MUSE_BOARD_WAVESHARE_C6_18
        default "sensecap_watcher" if MUSE_BOARD_SENSECAP_WATCHER
        default "m5stack_sticks3" if MUSE_BOARD_M5STACK_STICKS3
        default "m5stack_stickc_plus2" if MUSE_BOARD_M5STACK_STICKC_PLUS2
        default "m5stack_cardputer_adv" if MUSE_BOARD_M5STACK_CARDPUTER_ADV
        default "m5stack_stopwatch" if MUSE_BOARD_M5STACK_STOPWATCH
        default "m5stack_cores3" if MUSE_BOARD_M5STACK_CORES3
        default "none"

    # The Muse tools' serial port: the console UART behind the board's USB
    # bridge, where the chip's own USB Serial/JTAG isn't wired to a connector
    # (the Watcher's USB-C goes to a CH342) or the chip has none.
    config MUSE_CONSOLE_UART
        bool
        default y if MUSE_BOARD_SENSECAP_WATCHER || !SOC_USB_SERIAL_JTAG_SUPPORTED

    # A board overlay can raise this for a quiet speaker.
    config MUSE_DEFAULT_VOLUME
        int "Speaker volume until one is chosen in settings (percent)"
        range 0 100
        default 70

    config MUSE_WATCHER_CAMERA
        bool "SenseCAP Watcher camera capture and live preview"
        depends on MUSE_BOARD_SENSECAP_WATCHER && SPIRAM
        default n
        help
            Enable the camera.capture Home Link command and the wheel
            double-click camera preview. Camera buffers and tasks consume
            memory and preview decoding shares CPU time with voice and Link.
            Leave disabled to build without camera support.

    config MUSE_HATCH
        bool "Muse's own voice session"
        depends on MUSE_ENABLED
        default y if SPIRAM
        default n
        help
            Push-to-talk turns go over a voice session of Muse's own, to the
            VM Home Link is paired with or one set up on the device with a
            device token. Replies are text, shown as captions, and spoken with
            the speaker on if a TTS service is set below. Needs PSRAM. Without
            it, voice notes go over Home Link's own session to its paired VM
            and replies are shown as text.

    choice MUSE_TTS
        prompt "Spoken replies (TTS)"
        depends on MUSE_HATCH
        default MUSE_TTS_NONE
        help
            Muse replies in text. With a TTS service here and the speaker on,
            each reply message is sent to it and the MP3 it returns is played,
            the text on screen following the speech. If the service fails, the
            reply is shown at reading pace instead.

        config MUSE_TTS_NONE
            bool "None: replies are shown, not spoken"

        config MUSE_TTS_DEEPGRAM
            bool "Deepgram Aura (cloud API key)"
            help
                Deepgram's text to speech (api.deepgram.com/v1/speak). Needs an
                API key from console.deepgram.com; new accounts come with free
                credit.

        config MUSE_TTS_OPENAI
            bool "OpenAI-compatible server (Kokoro-FastAPI, OpenAI, ...)"
            help
                Any server with OpenAI's POST /v1/audio/speech: your own free
                one, such as Kokoro-FastAPI on a small VPS or a computer at
                home, or OpenAI's (with an API key).
    endchoice

    config MUSE_TTS_DEEPGRAM_KEY
        string "Deepgram API key"
        depends on MUSE_TTS_DEEPGRAM
        default ""
        help
            Kept in the build's sdkconfig, like the SDK token: never commit it.

    config MUSE_TTS_DEEPGRAM_MODEL
        string "Deepgram voice"
        depends on MUSE_TTS_DEEPGRAM
        default "aura-2-thalia-en"
        help
            A voice from developers.deepgram.com/docs/tts-models, for example
            aura-2-thalia-en or aura-2-andromeda-en.

    config MUSE_TTS_URL
        string "Speech endpoint URL"
        depends on MUSE_TTS_OPENAI
        default "http://tts.local:8880/v1/audio/speech"
        help
            The full URL of the speech endpoint (tts.local stands for your
            server's name or address). Kokoro-FastAPI listens on port 8880;
            OpenAI's is https://api.openai.com/v1/audio/speech. Use https for
            anything reached over the internet.

    config MUSE_TTS_API_KEY
        string "API key (sent as a Bearer token; empty for none)"
        depends on MUSE_TTS_OPENAI
        default ""

    config MUSE_TTS_MODEL
        string "Model"
        depends on MUSE_TTS_OPENAI
        default "kokoro"
        help
            "kokoro" for Kokoro-FastAPI; "tts-1" or "gpt-4o-mini-tts" for OpenAI.

    config MUSE_TTS_VOICE
        string "Voice"
        depends on MUSE_TTS_OPENAI
        default "af_heart"
        help
            Kokoro voices include af_heart, af_bella, bf_emma and, in French,
            ff_siwis; OpenAI's include alloy and nova. "auto" is for the
            Cloudflare Worker in tools/tts-worker: it tells each sentence's
            language, and the board's Settings > Language picks the one used
            when a sentence is too short to tell.

endmenu
```
